

/ {
	chosen {
    zephyr,display = &oled;
			zmk,kscan = &default_kscan;
		
	};

default_kscan: kscan {
		compatible = "zmk,kscan-gpio-direct";
		label = "default_kscan";							
       								
         


		input-gpios =
                <&pro_micro 10 (GPIO_ACTIVE_LOW | GPIO_PULL_UP)>,
                <&pro_micro 11 (GPIO_ACTIVE_LOW | GPIO_PULL_UP)>,
                <&pro_micro 12 (GPIO_ACTIVE_LOW | GPIO_PULL_UP)>,
                <&pro_micro 13 (GPIO_ACTIVE_LOW | GPIO_PULL_UP)>,                
                <&pro_micro 14 (GPIO_ACTIVE_LOW | GPIO_PULL_UP)>,
                <&pro_micro 15 (GPIO_ACTIVE_LOW | GPIO_PULL_UP)>,
                <&pro_micro 16 (GPIO_ACTIVE_LOW | GPIO_PULL_UP)>,
                <&pro_micro 17 (GPIO_ACTIVE_LOW | GPIO_PULL_UP)>;
 };

 };

 encoder: encoder {
		compatible = "alps,ec11";
		a-gpios = <&pro_micro 8 (GPIO_ACTIVE_HIGH | GPIO_PULL_UP)>;
		b-gpios = <&pro_micro 9 (GPIO_ACTIVE_HIGH | GPIO_PULL_UP)>;
		steps = <48>;
    status = "okay";
 };

 sensors: sensors {
		compatible = "zmk,keymap-sensors";
		sensors = <&encoder>;
		triggers-per-rotation = <12>;
 };


&pro_micro_i2c {
  status = "okay";

 oled: ssd1306@3c {
    compatible = "solomon,ssd1306fb";
    reg = <0x3c>;
    width = <128>;
    height = <32>;
    segment-offset = <0>;
    page-offset = <0>;
    display-offset = <0>;
    multiplex-ratio = <31>;
    com-invdir;
    segment-remap;
    com-sequential;
    prechargep = <0x22>;
  };
};
